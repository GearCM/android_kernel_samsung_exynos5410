## fs/exfat/Kconfig
```kconfig
config EXFAT_FS
	tristate "Microsoft exFat FileSystem"
	default y
	select NLS
	select NLS_UTF8
	help
	  If you want to use the exFAT file systems, then you must say Y or M here
	  to include exFAT support. 
```
